## firmware/drivers/Kconfig
```kconfig
menu "SD Driver"

    config FORMAT_IF_MOUNT_FAILED
        bool "Format the card if mount failed"
        default n
        help
            If this config item is set, format_if_mount_failed will be set to true and the card will be formatted if
            the mount has failed.
        
    config FORMAT_SD_CARD
        bool "Format the card as a part of the example"
        default n
        help
            If this config item is set, the card will be formatted as a part of the example.

    config PIN_MOSI
        int "MOSI GPIO number"
        default 11

    config PIN_MISO
        int "MISO GPIO number"
        default 13

    config PIN_CLK
        int "CLK GPIO number"
        default 12

    config PIN_CS
        int "CS GPIO number"
        default 10

endmenu
```

## firmware/sdkconfig.defaults
```kconfig
# Default Wi-Fi Connection Settings
CONFIG_EXAMPLE_WIFI_SSID="SKAR"
CONFIG_EXAMPLE_WIFI_PASSWORD="kristalA152-+0"

# Long filename support
CONFIG_FATFS_LFN_HEAP=y
CONFIG_FATFS_MAX_LFN=255
```
